## main/sdkconfig.defaults
```kconfig
# Necessary for the LED screen demos
CONFIG_ESP_MAIN_TASK_STACK_SIZE=7000

# NAPT demo (router)
CONFIG_LWIP_L2_TO_L3_COPY=y
CONFIG_LWIP_IP_FORWARD=y
CONFIG_LWIP_IPV4_NAPT=y

# SPI Ethernet demo
CONFIG_ETH_SPI_ETHERNET_DM9051=y
CONFIG_ETH_SPI_ETHERNET_W5500=y
CONFIG_ETH_SPI_ETHERNET_KSZ8851SNL=y

# Bigger headers are necessary for the QEMU demo
CONFIG_HTTPD_MAX_URI_LEN=1024
CONFIG_HTTPD_MAX_REQ_HDR_LEN=2048

# Workaround for https://github.com/espressif/esp-idf/issues/7631
CONFIG_MBEDTLS_CERTIFICATE_BUNDLE=n
CONFIG_MBEDTLS_CERTIFICATE_BUNDLE_DEFAULT_FULL=n

# Workaround for the experimental HTTP(S) TLS client demo
CONFIG_ESP_TLS_INSECURE=y
CONFIG_ESP_TLS_SKIP_SERVER_CERT_VERIFY=y

# Future: proper back-trace for esp32c3
#CONFIG_ESP_SYSTEM_USE_EH_FRAME=y

CONFIG_ESP32S2_ULP_COPROC_ENABLED=y
CONFIG_ESP32S2_ULP_COPROC_RESERVE_MEM=4096
CONFIG_ESP32S2_ULP_COPROC_RISCV=y

# speed post-sleep boot by disabling some checks
# https://docs.espressif.com/projects/esp-idf/en/latest/esp32s2/api-guides/bootloader.html#fast-boot-from-deep-sleep
CONFIG_SECURE_BOOT=n
CONFIG_BOOTLOADER_SKIP_VALIDATE_IN_DEEP_SLEEP=n
```
